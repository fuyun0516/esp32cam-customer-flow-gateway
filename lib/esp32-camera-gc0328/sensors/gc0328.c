// GC0328 support for esp32-camera.
// The initialization sequence is adapted from CanMV's Apache-2.0 GC0328 driver.

#include <stdint.h>
#include "freertos/FreeRTOS.h"
#include "freertos/task.h"
#include "esp_log.h"
#include "gc0328.h"
#include "sccb.h"

static const char *TAG = "gc0328";

static const uint8_t gc0328_default_regs[][2] = {
    {0xFE, 0x80}, {0xFE, 0x80},
    {0xFC, 0x16}, {0xFC, 0x16}, {0xFC, 0x16}, {0xFC, 0x16},
    {0xFE, 0x00}, {0x4F, 0x00}, {0x42, 0x00}, {0x03, 0x00},
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    {0xF2, 0x01}, {0x00, 0x00}
};

static int write_regs(uint8_t addr, const uint8_t regs[][2])
{
    for (size_t i = 0; regs[i][0] != 0 || regs[i][1] != 0; ++i) {
        if (SCCB_Write(addr, regs[i][0], regs[i][1]) != 0) {
            ESP_LOGE(TAG, "register write failed at 0x%02x", regs[i][0]);
            return -1;
        }
    }
    return 0;
}

static int reset(sensor_t *sensor)
{
    int ret = write_regs(sensor->slv_addr, gc0328_default_regs);
    vTaskDelay(pdMS_TO_TICKS(80));
    return ret;
}

static int set_pixformat(sensor_t *sensor, pixformat_t pixformat)
{
    if (pixformat != PIXFORMAT_YUV422) {
        ESP_LOGW(TAG, "only YUV422 is enabled");
        return -1;
    }
    SCCB_Write(sensor->slv_addr, 0xFE, 0x00);
    int ret = SCCB_Write(sensor->slv_addr, 0x44, 0x00);
    if (ret == 0) {
        sensor->pixformat = pixformat;
    }
    return ret;
}

static int set_framesize(sensor_t *sensor, framesize_t framesize)
{
    if (framesize != FRAMESIZE_QVGA && framesize != FRAMESIZE_VGA) {
        framesize = FRAMESIZE_QVGA;
    }

    const uint16_t width = resolution[framesize].width;
    const uint16_t height = resolution[framesize].height;
    int ret = 0;
    ret |= SCCB_Write(sensor->slv_addr, 0xFE, 0x00);
    ret |= SCCB_Write(sensor->slv_addr, 0x50, 0x01);
    ret |= SCCB_Write(sensor->slv_addr, 0x51, 0x00);
    ret |= SCCB_Write(sensor->slv_addr, 0x52, 0x00);
    ret |= SCCB_Write(sensor->slv_addr, 0x53, 0x00);
    ret |= SCCB_Write(sensor->slv_addr, 0x54, 0x00);
    ret |= SCCB_Write(sensor->slv_addr, 0x55, height >> 8);
    ret |= SCCB_Write(sensor->slv_addr, 0x56, height & 0xff);
    ret |= SCCB_Write(sensor->slv_addr, 0x57, width >> 8);
    ret |= SCCB_Write(sensor->slv_addr, 0x58, width & 0xff);
    ret |= SCCB_Write(sensor->slv_addr, 0x59,
                      framesize == FRAMESIZE_VGA ? 0x11 : 0x22);
    ret |= SCCB_Write(sensor->slv_addr, 0x5A,
                      framesize == FRAMESIZE_VGA ? 0x02 : 0x00);
    if (ret == 0) {
        sensor->status.framesize = framesize;
    }
    vTaskDelay(pdMS_TO_TICKS(30));
    return ret;
}

static int init_status(sensor_t *sensor)
{
    sensor->status.framesize = FRAMESIZE_QVGA;
    sensor->status.hmirror = 0;
    sensor->status.vflip = 0;
    sensor->status.awb = 1;
    sensor->status.agc = 1;
    sensor->status.aec = 1;
    return 0;
}

static int set_hmirror(sensor_t *sensor, int enable)
{
    SCCB_Write(sensor->slv_addr, 0xFE, 0x00);
    uint8_t value = SCCB_Read(sensor->slv_addr, 0x17) & 0xFC;
    value |= enable ? 0x01 : 0;
    value |= sensor->status.vflip ? 0x02 : 0;
    int ret = SCCB_Write(sensor->slv_addr, 0x17, value);
    if (ret == 0) sensor->status.hmirror = !!enable;
    return ret;
}

static int set_vflip(sensor_t *sensor, int enable)
{
    SCCB_Write(sensor->slv_addr, 0xFE, 0x00);
    uint8_t value = SCCB_Read(sensor->slv_addr, 0x17) & 0xFC;
    value |= sensor->status.hmirror ? 0x01 : 0;
    value |= enable ? 0x02 : 0;
    int ret = SCCB_Write(sensor->slv_addr, 0x17, value);
    if (ret == 0) sensor->status.vflip = !!enable;
    return ret;
}

static int set_dummy(sensor_t *sensor, int value)
{
    (void)sensor;
    (void)value;
    return 0;
}

static int set_gainceiling_dummy(sensor_t *sensor, gainceiling_t value)
{
    (void)sensor;
    (void)value;
    return 0;
}

static int get_reg(sensor_t *sensor, int reg, int mask)
{
    return SCCB_Read(sensor->slv_addr, reg) & mask;
}

static int set_reg(sensor_t *sensor, int reg, int mask, int value)
{
    uint8_t old_value = SCCB_Read(sensor->slv_addr, reg);
    return SCCB_Write(sensor->slv_addr, reg,
                      (old_value & ~mask) | (value & mask));
}

int gc0328_detect(int slv_addr, sensor_id_t *id)
{
    if (slv_addr != GC0328_SCCB_ADDR) {
        return 0;
    }
    SCCB_Write(slv_addr, 0xFE, 0x00);
    uint8_t pid = SCCB_Read(slv_addr, 0xF0);
    if (pid != GC0328_PID) {
        ESP_LOGI(TAG, "PID mismatch: 0x%02x", pid);
        return 0;
    }
    id->PID = pid;
    return pid;
}

int gc0328_init(sensor_t *sensor)
{
    sensor->init_status = init_status;
    sensor->reset = reset;
    sensor->set_pixformat = set_pixformat;
    sensor->set_framesize = set_framesize;
    sensor->set_contrast = set_dummy;
    sensor->set_brightness = set_dummy;
    sensor->set_saturation = set_dummy;
    sensor->set_sharpness = set_dummy;
    sensor->set_denoise = set_dummy;
    sensor->set_gainceiling = set_gainceiling_dummy;
    sensor->set_quality = set_dummy;
    sensor->set_colorbar = set_dummy;
    sensor->set_whitebal = set_dummy;
    sensor->set_gain_ctrl = set_dummy;
    sensor->set_exposure_ctrl = set_dummy;
    sensor->set_hmirror = set_hmirror;
    sensor->set_vflip = set_vflip;
    sensor->set_aec2 = set_dummy;
    sensor->set_awb_gain = set_dummy;
    sensor->set_agc_gain = set_dummy;
    sensor->set_aec_value = set_dummy;
    sensor->set_special_effect = set_dummy;
    sensor->set_wb_mode = set_dummy;
    sensor->set_ae_level = set_dummy;
    sensor->set_dcw = set_dummy;
    sensor->set_bpc = set_dummy;
    sensor->set_wpc = set_dummy;
    sensor->set_raw_gma = set_dummy;
    sensor->set_lenc = set_dummy;
    sensor->get_reg = get_reg;
    sensor->set_reg = set_reg;
    sensor->set_res_raw = NULL;
    sensor->set_pll = NULL;
    sensor->set_xclk = NULL;
    ESP_LOGI(TAG, "GC0328 attached");
    return 0;
}
